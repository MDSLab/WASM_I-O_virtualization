## west.yml
```yaml
# my-app/west.yml
manifest:
  version: "1.2"

  remotes:
    - name: micro-ros
      url-base: https://github.com/micro-ROS

  projects:
    - name: zephyr
      url: https://github.com/zephyrproject-rtos/zephyr
      revision: v4.1.0
      import:
        path-prefix: deps
        name-allowlist:
          - cmsis          # richiesto da ARM/STM32 (Cortex-M)
          - hal_stm32      # HAL STM32Cube
          - hal_espressif  # driver ESP-IDF per Zephyr

    - name: micro_ros_zephyr_module
      url: https://github.com/micro-ROS/micro_ros_zephyr_module
      revision: humble
      path: modules/lib/micro_ros

  self:
    path: my-app
```

## zephyr_micro_ros/west.yml
```yaml
manifest:
  defaults:
    remote: zephyr

  remotes:
    - name: zephyr
      url-base: https://github.com/zephyrproject-rtos
    - name: microros
      url-base: https://github.com/micro-ROS

  projects:
    - name: zephyr
      remote: zephyr
      revision: v4.1.0
      import: true

    - name: micro_ros_zephyr_module
      remote: microros
      revision: main          # oppure 'jazzy' / 'iron' / 'kilted' in base alla tua distro ROS 2
      path: modules/micro_ros

  self:
    path: app
```
